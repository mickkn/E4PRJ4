/* ========================================
 *
 * Copyright YOUR COMPANY, THE YEAR
 * All Rights Reserved
 * UNPUBLISHED, LICENSED SOFTWARE.
 *
 * CONFIDENTIAL AND PROPRIETARY INFORMATION
 * WHICH IS THE PROPERTY OF your company.
 *
 * ========================================
*/
#include <project.h>
#include <fixedMath.h>
#include <stdio.h>

#define ANGLE_INC 4120  // 2^17*Pi/200 = 2060 dvs f*2060 = AngINC
#define DELAY_US 9961 //the delay added to the 38.5 us delay generated by the computations. sine freq = 1/(200*(delayu + 38,5u)) OBS 2Hz = delay 2462
#define SINE_PP 1966080 // 80 * 2^16 - the peak to peak value of the duty cycle sine in 16.16 fixed point. 

int ready = 0;

CY_ISR(PWM_ISR)
{   
    ready = 1;
}


int main()
{
    /* Place your initialization/startup code here (e.g. MyInst_Start()) */
    UART_Start();
    UART_UartPutString("Welcome to Baby Watch: Vuggesystem - Vuggetest\r\n");
    PWM_Start();
    Timer_Start();
    
    CyGlobalIntEnable; /* Uncomment this line to enable global interrupts. */
    isr_1_StartEx(PWM_ISR);
    
    
    /* Place your application code here. */
        
    UART_UartPutString("Running test\r\n\n");
    fix16_t i = 0;
    uint8_t going_up = 1;

    while(1)
    {
        CyPins_ClearPin(ISR_Pin_0);
       
        while(!ready);
        CyPins_SetPin(ISR_Pin_0);   
    
        uint8_t comp = (fix16mul(SINE_PP, fix16sin(i))>>16) + 100; //80*sin(i) + 100 done in fixed point math and scaled back to integer format
        char str[10];
        sprintf(str, "%d, ", comp);
        UART_UartPutString(str);
        PWM_WriteCompare(comp);
        //CyDelayUs(DELAY_US);

        if(i >= half_pi)
        {
            going_up = 0;
            CyPins_SetPin(Pin_1_0);
        } 
        else if (i <= -half_pi)
        {
            going_up = 1;
            CyPins_ClearPin(Pin_1_0);
        }
        
        if(going_up)  i += ANGLE_INC;
        else          i -= ANGLE_INC;
    
        ready = 0;
    }
}

/* [] END OF FILE */
